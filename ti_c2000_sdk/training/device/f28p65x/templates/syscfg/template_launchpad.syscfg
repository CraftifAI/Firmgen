/**
 * These arguments were used when this file was generated. They will be automatically applied on subsequent loads
 * via the GUI or CLI. Run CLI with '--help' for additional information on how to override these arguments.
 * @cliArgs --board "/boards/LAUNCHXL-F28P65" --product "C2000WARE@4.01.00.00"
 * @versions {"tool":"1.11.0+2225"}
 */

/**
 * Import the modules used in this configuration.
 */
// Add your modules here
// Example:
// const led       = scripting.addModule("/driverlib/board_components/led", {}, false);
// const led1      = led.addInstance();
// const cputimer  = scripting.addModule("/driverlib/cputimer.js", {}, false);
// const cputimer1 = cputimer.addInstance();

/**
 * Write custom configuration values to the imported modules.
 */
// Configure your modules here
// Example:
// led1.$name                  = "myBoardLED0";
// led1.$hardware              = system.deviceData.board.components.D1;
// led1.gpio.writeInitialValue = true;
// led1.gpio.initialValue      = 1;

/**
 * Pinmux solution for unlocked pins/peripherals. This ensures that minor changes to the automatic solver in a future
 * version of the tool will not impact the pinmux you originally saw.  These lines can be completely deleted in order to
 * re-solve from scratch.
 */
// Add pinmux solutions here
// Example:
// led1.gpio.gpioPin.$suggestSolution = "hsecDigital.74";