/**
 * These arguments were used when this file was generated. They will be automatically applied on subsequent loads
 * via the GUI or CLI. Run CLI with '--help' for additional information on how to override these arguments.
 * @cliArgs --board "/boards/LAUNCHXL_F28E12X" --device "F28E12x" --part "F28E12x_48PT" --package "48PT" --context "system" --product "C2000WARE@5.03.00.00"
 * @v2CliArgs --board "/boards/LAUNCHXL_F28E12X" --device "F28E120SB" --package "48PT" --context "system" --product "C2000WARE@5.03.00.00"
 * @versions {"tool":"1.23.0+3914"}
 */
