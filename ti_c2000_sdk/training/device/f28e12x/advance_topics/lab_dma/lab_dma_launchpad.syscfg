/**
 * @cliArgs --board "/boards/LAUNCHXL_F28E12X" --device "F28E12x" --part "F28E12x_48PT" --package "48PT" --context "system" --product "C2000WARE@6.00.00.00"
 * @versions {"tool":"1.24.0+4109"}
 */

/**
 * Import the modules used in this configuration.
 */
const adc       = scripting.addModule("/driverlib/adc.js", {}, false);
const adc1      = adc.addInstance();
const analog    = scripting.addModule("/driverlib/analog.js", {}, false);
const analog1   = analog.addInstance();
const asysctl   = scripting.addModule("/driverlib/asysctl.js");
const led       = scripting.addModule("/driverlib/board_components/led", {}, false);
const led1      = led.addInstance();
const cputimer  = scripting.addModule("/driverlib/cputimer.js", {}, false);
const cputimer1 = cputimer.addInstance();
const dma       = scripting.addModule("/driverlib/dma.js", {}, false);
const dma1      = dma.addInstance();
const mcpwm     = scripting.addModule("/driverlib/mcpwm.js");
const mcpwm1    = mcpwm.addInstance();
const mcpwm2    = mcpwm.addInstance();

/**
 * Write custom configuration values to the imported modules.
 */
adc1.$name                             = "myADC0";
adc1.adcClockPrescaler                 = "ADC_CLK_DIV_4_0";
adc1.enabledSOCs                       = ["ADC_SOC_NUMBER0"];
adc1.soc0Trigger                       = "ADC_TRIGGER_MCPWM3_SOCA";
adc1.interruptPulseMode                = "ADC_PULSE_END_OF_CONV";
adc1.enabledInts                       = ["ADC_INT_NUMBER1"];
adc1.enableInterrupt1                  = true;
adc1.enableInterrupt1ContinuousMode    = true;
adc1.enabledDMAInts                    = ["ADC_INT_NUMBER1"];
adc1.soc0SampleWindow                  = 8;
adc1.enableDMAInterrupt1               = true;
adc1.enableDMAInterrupt1ContinuousMode = true;

analog1.$name            = "myANALOGPinMux0";
adc1.analog              = analog1;
analog1.useCase          = "CUSTOM";
analog1.useInterfacePins = ["A0/CMP3_LITE_DACL/PGA1_INM2"];

asysctl.analogReference        = "INTERNAL";
asysctl.analogReferenceVoltage = "1P65";

led1.$name     = "myBoardLED0";
led1.$hardware = system.deviceData.board.components.LED5;

cputimer1.$name       = "myCPUTIMER0";
cputimer1.timerPeriod = 4294967295;

dma1.$name                   = "myDMA0";
dma1.continuousModeConfig    = "DMA_CFG_CONTINUOUS_ENABLE";
dma1.enableTriggers          = true;
dma1.useInterrupts           = true;
dma1.registerInterrupts      = true;
dma1.enableInterrupts        = true;
dma1.emulationMode           = "DMA_EMULATION_FREE_RUN";
dma1.transferSize            = 50;
dma1.startChannel            = true;
dma1.srcAddressInputMode     = "VARIABLE";
dma1.srcAddressVariable      = "AdcAddr";
dma1.srcWrapSize             = 50;
dma1.destAddressInputMode    = "VARIABLE";
dma1.destAddressVariable     = "AdcRawBufAddr";
dma1.destWrapSize            = 50;
dma1.destTransferStep        = 1;
dma1.triggerSource           = "DMA_TRIGGER_ADCA1";
dma1.dmaInt.interruptHandler = "dma_Ch1ISR";
dma1.dmaInt.enableInterrupt  = true;

mcpwm.commentOutDefaultCode = true;

mcpwm1.$name                                                         = "myMCPWM0";
mcpwm1.useCase                                                       = "CUSTOM";
mcpwm1.useInterfacePins                                              = ["MCPWM#_1A","MCPWM#_1B"];
mcpwm1.mcpwmTimebase_period                                          = 25000;
mcpwm1.mcpwmTimebase_counterMode                                     = "MCPWM_COUNTER_MODE_UP_DOWN";
mcpwm1.mcpwmCounterCompare_cmpA                                      = 18750;
mcpwm1.mcpwmActionQualifier_MCPWM_AQ_OUTPUT_1A_ON_TIMEBASE_UP_CMPA   = "MCPWM_AQ_OUTPUT_HIGH";
mcpwm1.mcpwmActionQualifier_MCPWM_AQ_OUTPUT_1A_ON_TIMEBASE_DOWN_CMPA = "MCPWM_AQ_OUTPUT_LOW";
mcpwm1.mcpwm.mcpwm_1aPin.$assign                                     = "boosterpack1.40";
scripting.suppress("Connected to hardware,@@@.+?@@@ is connected to MCPWM BP on the LAUNCHXL-F28E12X\\. Consider selecting it in \'use hardware\' above\\. @@@.+?@@@", mcpwm1.mcpwm, "mcpwm_1aPin");

mcpwm2.$name                                               = "myMCPWM1";
mcpwm2.useCase                                             = "CUSTOM";
mcpwm2.mcpwmTimebase_period                                = 1999;
mcpwm2.mcpwmTimebase_counterMode                           = "MCPWM_COUNTER_MODE_UP";
mcpwm2.mcpwmEventTrigger_MCPWM_SOC_A_triggerEnable         = true;
mcpwm2.mcpwmEventTrigger_MCPWM_SOC_A_triggerSource         = "MCPWM_SOC_TBCTR_ZERO_PERIOD";
mcpwm2.mcpwmEventTrigger_MCPWM_SOC_A_triggerEventPrescalar = "1";
