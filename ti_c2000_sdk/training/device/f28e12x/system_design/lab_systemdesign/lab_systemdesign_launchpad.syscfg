/**
 * @cliArgs --board "/boards/LAUNCHXL_F28E12X" --device "F28E12x" --part "F28E12x_48PT" --package "48PT" --product "C2000WARE@6.00.00.00_EA1"
 * @versions {"tool":"1.24.0+4110"}
 */

/**
 * Import the modules used in this configuration.
 */
const adc         = scripting.addModule("/driverlib/adc.js", {}, false);
const adc1        = adc.addInstance();
const analog      = scripting.addModule("/driverlib/analog.js", {}, false);
const analog1     = analog.addInstance();
const asysctl     = scripting.addModule("/driverlib/asysctl.js");
const led         = scripting.addModule("/driverlib/board_components/led", {}, false);
const led1        = led.addInstance();
const cmpss_lite  = scripting.addModule("/driverlib/cmpss_lite.js", {}, false);
const cmpss_lite1 = cmpss_lite.addInstance();
const mcpwm       = scripting.addModule("/driverlib/mcpwm.js");
const mcpwm1      = mcpwm.addInstance();
const pwmxbar     = scripting.addModule("/driverlib/pwmxbar.js", {}, false);
const pwmxbar1    = pwmxbar.addInstance();

/**
 * Write custom configuration values to the imported modules.
 */
adc1.adcClockPrescaler       = "ADC_CLK_DIV_4_0";
adc1.enabledSOCs             = ["ADC_SOC_NUMBER0"];
adc1.soc0Channel             = "ADC_CH_ADCIN4";
adc1.soc0Trigger             = "ADC_TRIGGER_MCPWM1_SOCA";
adc1.interruptPulseMode      = "ADC_PULSE_END_OF_CONV";
adc1.enabledInts             = ["ADC_INT_NUMBER1"];
adc1.enableInterrupt1        = true;
adc1.registerInterrupts      = ["1"];
adc1.$name                   = "myADCA";
adc1.soc0SampleWindow        = 12;
adc1.adcInt1.enableInterrupt = true;

asysctl.analogReference        = "INTERNAL";
asysctl.analogReferenceVoltage = "1P65";

led1.$name     = "myBoardLED0";
led1.$hardware = system.deviceData.board.components.LED4;

cmpss_lite1.enableModule   = true;
cmpss_lite1.cmpssLiteBase  = "CMPSSLITE2_BASE";
cmpss_lite1.dacValHigh     = 2500;
cmpss_lite1.$name          = "myCMPSS";
cmpss_lite1.highCompInvert = true;

analog1.$name            = "myANALOGPinMux0";
adc1.analog              = analog1;
cmpss_lite1.analog       = analog1;
analog1.useCase          = "CUSTOM";
analog1.useInterfacePins = ["A12","A4/PGA1_INM1"];

mcpwm.commentOutDefaultCode = true;

mcpwm1.$name                                                         = "myMCPWM0";
mcpwm1.useCase                                                       = "CUSTOM";
mcpwm1.mcpwmTimebase_period                                          = 1000;
mcpwm1.mcpwmTimebase_counterMode                                     = "MCPWM_COUNTER_MODE_UP_DOWN";
mcpwm1.mcpwmCounterCompare_cmpA                                      = 500;
mcpwm1.useInterfacePins                                              = ["MCPWM#_1A"];
mcpwm1.mcpwmActionQualifier_MCPWM_AQ_OUTPUT_1A_ON_TIMEBASE_UP_CMPA   = "MCPWM_AQ_OUTPUT_HIGH";
mcpwm1.mcpwmActionQualifier_MCPWM_AQ_OUTPUT_1A_ON_TIMEBASE_DOWN_CMPA = "MCPWM_AQ_OUTPUT_LOW";
mcpwm1.mcpwmEventTrigger_MCPWM_SOC_A_triggerEnable                   = true;
mcpwm1.mcpwmEventTrigger_MCPWM_SOC_A_triggerSource                   = "MCPWM_SOC_TBCTR_U_CMP1A";
mcpwm1.mcpwmEventTrigger_MCPWM_SOC_A_triggerEventPrescalar           = "1";
mcpwm1.mcpwmTripZone_MCPWM_TZ_ACTION_EVENT_TZB                       = "MCPWM_TZ_ACTION_DISABLE";
mcpwm1.mcpwmTripZone_oneShotSource                                   = ["MCPWM_TZ_SIGNAL_OSHT4"];
mcpwm1.mcpwmTripZone_MCPWM_TZ_ACTION_EVENT_TZA                       = "MCPWM_TZ_ACTION_LOW";
mcpwm1.mcpwm.mcpwm_1aPin.$assign                                     = "boosterpack1.40";

pwmxbar1.$name     = "myPWMXBAR0";
pwmxbar1.tripInput = "XBAR_TRIP4";
pwmxbar1.muxesUsed = ["XBAR_MUX02"];
