## esp32-s3-devkitc-1-n32r8v/05_examples/peripherals/camera/mipi_isp_dsi/sdkconfig.defaults.esp32p4
```kconfig
CONFIG_IDF_EXPERIMENTAL_FEATURES=y
CONFIG_SPIRAM=y
CONFIG_SPIRAM_SPEED_200M=y
CONFIG_ESP32P4_SELECTS_REV_LESS_V3=y
CONFIG_ESP32P4_REV_MIN_100=y
CONFIG_ESP_DEFAULT_CPU_FREQ_MHZ_360=y
```
